#define VERSION_MACRO
macro_ver: macro_ver {
compatible = "zmk,behavior-macro";
#binding-cells = <0>;
bindings = <&kp N2>, <&kp N0>, <&kp N2>, <&kp N5>, <&kp N1>, <&kp N2>, <&kp N0>, <&kp N5>, <&kp MINUS>, <&kp D>, <&kp E>, <&kp V>, <&kp MINUS>, <&kp N9>, <&kp A>, <&kp N2>, <&kp C>, <&kp A>, <&kp N9>, <&kp D>, <&kp MINUS>, <&kp C>, <&kp L>, <&kp I>, <&kp Q>, <&kp U>, <&kp E>, <&kp RET>;
};
